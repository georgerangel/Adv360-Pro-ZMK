#define VERSION_MACRO
macro_ver: macro_ver {
compatible = "zmk,behavior-macro";
label = "macro_ver";
#binding-cells = <0>;
bindings = <&kp N2>, <&kp N0>, <&kp N2>, <&kp N5>, <&kp N0>, <&kp N1>, <&kp N1>, <&kp N9>, <&kp MINUS>, <&kp D>, <&kp E>, <&kp F>, <&kp A>, <&kp MINUS>, <&kp N3>, <&kp F>, <&kp F>, <&kp D>, <&kp N9>, <&kp N7>, <&kp N5>, <&kp RET>;
};
